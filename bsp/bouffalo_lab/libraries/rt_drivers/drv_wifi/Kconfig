## bsp/bouffalo_lab/libraries/rt_drivers/drv_wifi/Kconfig
```kconfig
    config BSP_USING_WIFI
        bool "Enable WiFi"
        select PKG_USING_FREERTOS_WRAPPER
        default n
```

## bsp/cvitek/c906_little/board/Kconfig
```kconfig
menu "General Drivers Configuration"

    menuconfig BSP_USING_UART
        bool "Using UART"
        select RT_USING_SERIAL
        default y

        if BSP_USING_UART
            config RT_USING_UART0
            bool "Enable UART 0"
            default n

            config RT_USING_UART1
            bool "Enable UART 1"
            default y

            config UART_IRQ_BASE
            int
            default 30
        endif

    source "$BSP_DIR/../drivers/Kconfig"

endmenu
```

## bsp/cvitek/cv18xx_risc-v/board/Kconfig
```kconfig
menu "General Drivers Configuration"

    menuconfig BSP_USING_UART
        bool "Using UART"
        select RT_USING_SERIAL
        default y

        if BSP_USING_UART
            config RT_USING_UART0
            bool "Enable UART 0"
            default y

            config UART_IRQ_BASE
            int
            default 44
            
            config RT_USING_UART1
            bool "Enable UART 1"
            default n

            config RT_USING_UART2
            bool "Enable UART 2"
            default n

            config RT_USING_UART3
            bool "Enable UART 3"
            default n

            config RT_USING_UART4
            bool "Enable UART 4"
            default n

        endif

    source "$BSP_DIR/../drivers/Kconfig"

    config BSP_USING_SDH
        select RT_USING_SDIO
        select RT_USING_DFS
        select RT_USING_DFS_ELMFAT
        select RT_USING_DFS_ROMFS
        bool "Enable Secure Digital Host Controller"
        default n

    config BSP_USING_ETH
        bool "Enable Ethernet"
        default n
        select RT_USING_LWIP
        select RT_USING_POSIX_FS
        select RT_USING_POSIX_SOCKET

endmenu
```
